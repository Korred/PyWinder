// fibra_winder_v1.pde
// -*- mode: C++ -*-
//
// Copyright (C) 2018 Philipp Kochanski

#include <U8g2lib.h>
#include <AccelStepper.h>
#include <elapsedMillis.h>

// I2C 128x64 OLED DISPLAY
U8G2_SSD1306_128X64_NONAME_F_HW_I2C u8g2(U8G2_R0, /* reset=*/ U8X8_PIN_NONE);

// Button PINS
#define DOWN 2
#define UP 3
#define CONFIRM 4
#define RETURN 5

// Limit Switch PINS
#define LSWITCH_L 6
#define LSWITCH_R 7

// Stepper PINS
#define X_STEP 8
#define X_DIR 9
#define Y_STEP 10
#define Y_DIR 11

// Logo width/height
#define fibra_logo_width 128
#define fibra_logo_height 64

static const unsigned char fibra_logo_bits[] U8X8_PROGMEM = {
   0xff, 0xff, 0xff, 0xff, 0xff, 0xff, 0xff, 0xff, 0xff, 0xff, 0xff, 0xff,
   0xff, 0xff, 0xff, 0xff, 0xff, 0xff, 0xff, 0xff, 0xff, 0xff, 0xff, 0xff,
   0xff, 0xff, 0xff, 0xff, 0xff, 0xff, 0xff, 0xff, 0xff, 0xff, 0xff, 0xff,
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   0xff, 0xff, 0xff, 0xff 
};



void draw_logo(void){
  u8g2.clearBuffer();
  u8g2.drawXBMP( 0, 0, fibra_logo_width, fibra_logo_height, fibra_logo_bits);
  u8g2.sendBuffer();
}

void draw_test_menu(void){
  u8g2.setFont(u8g2_font_helvR08_te);
  u8g2.drawStr(35,8,"System Test");
  u8g2.drawHLine(0,9,128);
  u8g2.drawStr(0,22,"Stepper X");
  u8g2.drawStr(0,32,"Stepper Y");
  u8g2.drawStr(0,42,"Limit-X (l)");
  u8g2.drawStr(0,52,"Limit-X (r)");
  u8g2.drawVLine(50,13,50);

  u8g2.setFont(u8g2_font_open_iconic_check_1x_t);
  u8g2.drawGlyph(85, 22, 0x0040);  
  u8g2.drawGlyph(85, 32, 0x0044);  
  u8g2.drawGlyph(85, 42, 0x0040);  
  u8g2.drawGlyph(85, 52, 0x0044);   
}

void setup() {
  Serial.begin(9600);
  delay(5);
  u8g2.begin();

  draw_logo();
  delay(3000);
}

void show_main_menu(int pos){
  char* names[] = {"Winding", "Settings", "System Test", "About"};
  int name_pos[] = {22, 33, 44, 55};
  int box_pos[] = {13, 24, 35, 46};

  u8g2.clearBuffer();

  //8pt font size
  u8g2.setFont(u8g2_font_helvR08_te);
  u8g2.setFontMode(1);

  //Title + Line
  u8g2.drawStr(20,8,"Fibra Winder v.1.0");
  u8g2.drawHLine(0,9,128);

  //White (1) Box with Black (0) font (selected option)
   for(int i = 0; i < 4; i++){
     Serial.println(pos);
     u8g2.setDrawColor(1);
      if (i == pos){
        u8g2.setDrawColor(1);
        u8g2.drawBox(0,box_pos[i],128,10);
        u8g2.setDrawColor(0);
        u8g2.drawStr(2,name_pos[i],names[i]);
      }
      u8g2.drawStr(2,name_pos[i],names[i]);

   }

  u8g2.sendBuffer();
}

int move_main_menu(int cur_pos, int dir){
  // up   =  1
  // down = -1
  char* names[] = {"Winding", "Settings", "System Test", "About"};
  int name_pos[] = {22, 33, 44, 55};
  int box_pos[] = {13, 24, 35, 46};

  // return currrent position if out of boundries move detected
  if ((cur_pos == 0 && dir == 1) || (cur_pos == 3 && dir == -1)){
    return cur_pos;
  }


  // redraw current pos
  u8g2.setDrawColor(0); 
  u8g2.drawBox(0,box_pos[cur_pos],128,10);
  u8g2.setDrawColor(1);
  u8g2.drawStr(2,name_pos[cur_pos],names[cur_pos]);

  if (dir == 1){
    cur_pos--;
  }

  if (dir == -1){
    cur_pos++;
  }

  // redraw next pos
  u8g2.drawBox(0,box_pos[cur_pos],128,10);
  u8g2.setDrawColor(0);
  u8g2.drawStr(2,name_pos[cur_pos],names[cur_pos]);


  u8g2.sendBuffer();
  return cur_pos;

}

void main_menu(void){

  int curr_option = 0;
  bool down_button = false;
  bool up_button = false;
  bool conf_button = false;

  show_main_menu(0);

  while(true){
      down_button = digitalRead(DOWN);
      up_button = digitalRead(UP);
      conf_button = digitalRead(CONFIRM);

      if (conf_button){
        
        switch (curr_option)
        {
          case 0:
            delay(100);
            winding_menu();
            show_main_menu(curr_option);
            break;
          case 1:
            delay(100);
            break;
          case 2:
            delay(100);
            break;
          case 3:
            delay(100);
            about_menu();
            show_main_menu(curr_option);
            break;
        }

        delay(400);
        
      }

      if (down_button){
        Serial.println("DOWN");
        curr_option = move_main_menu(curr_option, -1);
        delay(400);
      }

      if (up_button){
        Serial.println("UP");
        curr_option = move_main_menu(curr_option, 1);
        delay(400);
      }
  } 
}

void winding_menu_test(void){
  elapsedMillis sinceTest1 = 0;
  char char_remain[40];
  while(true){
    
    Serial.println("SHOW WINDING");
    u8g2.clearBuffer();

    u8g2.setDrawColor(1);
    
    //8pt font size
    u8g2.setFont(u8g2_font_helvR08_te);
    u8g2.setFontMode(1);

    u8g2.drawStr(2,34,"Time remaining:");


    u8g2.drawStr(2,45,"Completed:");
    u8g2.drawFrame(2,48,124,15);

    u8g2.sendBuffer();

    float prcnt;
    unsigned long secPassed;
    int runHours;
    int secsRemaining;
    int runMinutes;
    int runSeconds;

    
    for(int i = 1; i<123; i++){
      secPassed = (120000 - sinceTest1)/1000;
      runHours= secPassed/3600;
      secsRemaining=secPassed%3600;
      runMinutes=secsRemaining/60;
      runSeconds=secsRemaining%60;
      

    u8g2.setDrawColor(0);
    u8g2.drawBox(80,26,62, 15);
    u8g2.setDrawColor(1);
    sprintf(char_remain,"%02d:%02d:%02d",runHours,runMinutes,runSeconds);
    u8g2.drawStr(80,34, char_remain);
      
      prcnt = (122/100) * i;
      u8g2.drawLine(2+int(prcnt), 48, 2+int(prcnt), 62);
      u8g2.sendBuffer();
    }
  }
}



void start_winding(int angle, int len, int passes){

}

int change_winding_angle(int angle){
}

int change_winding_length(int len){
}

int change_winding_passes(int passes){
}



int move_winding_menu(int cur_pos, int dir, int angle, int len, int passes){
  Serial.println("<<<MOVE WINDING MENU>>>");
  // up   =  1
  // down = -1
  char* names[] = {"Angle", "Length", "Passes", "Start"};
  
  int settings[] = {angle, len, passes};
  char stringBuffer[16];
  char* values[3];
  for(int i = 0; i<3; i++){
    snprintf(stringBuffer, 16, "%d", settings[i]);
    values[i] = strdup(stringBuffer);
  }

  int name_pos[] = {22, 33, 44, 55};
  int box_pos[] = {13, 24, 35, 46};

  // return currrent position if out of boundries move detected
  if ((cur_pos == 0 && dir == 1) || (cur_pos == 3 && dir == -1)){
    return cur_pos;
  }


  // redraw current pos
  u8g2.setDrawColor(0); 
  u8g2.drawBox(0,box_pos[cur_pos],40,10);
  u8g2.setDrawColor(1);
  u8g2.drawStr(2,name_pos[cur_pos],names[cur_pos]);

  /*
  if(cur_pos != 3){
      u8g2.drawStr(50,name_pos[cur_pos],values[cur_pos]);
  }
  */


  if (dir == 1){
    cur_pos--;
  }

  if (dir == -1){
    cur_pos++;
  }

  // redraw next pos
  u8g2.drawBox(0,box_pos[cur_pos],40,10);
  u8g2.setDrawColor(0);
  u8g2.drawStr(2,name_pos[cur_pos],names[cur_pos]);

  if(cur_pos != 3){
      u8g2.setDrawColor(1);
      u8g2.drawStr(50,name_pos[cur_pos],values[cur_pos]);
  }


  u8g2.sendBuffer();
  return cur_pos;

}


void show_winding_menu(int pos, int angle, int len, int passes){
  Serial.println("<<<SHOW WINDING MENU>>>");
  char* names[] = {"Angle", "Length", "Passes", "Start"};
  
  int settings[] = {angle, len, passes};
  char stringBuffer[16];
  char* values[3];
  for(int i = 0; i<3; i++){
    snprintf(stringBuffer, 16, "%d", settings[i]);
    values[i] = strdup(stringBuffer);
    Serial.println(values[i]);
  }
  
  int name_pos[] = {22, 33, 44, 55};
  int box_pos[] = {13, 24, 35, 46};

  u8g2.clearBuffer();

  //8pt font size
  u8g2.setFont(u8g2_font_helvR08_te);
  u8g2.setFontMode(1);

  //Title + Line
  u8g2.drawStr(20,8,"Winding");
  u8g2.drawHLine(0,9,128);

  //White (1) Box with Black (0) font (selected option)
   for(int i = 0; i < 4; i++){
     Serial.println(pos);
     u8g2.setDrawColor(1);
      if (i == pos){
        u8g2.setDrawColor(1);
        u8g2.drawBox(0,box_pos[i],40,10);
        u8g2.setDrawColor(0);
        u8g2.drawStr(2,name_pos[i],names[i]);
        /*
        if (i != 3){
          u8g2.drawStr(50,name_pos[i],values[i]);
        }
        */
        
      }
      u8g2.drawStr(2,name_pos[i],names[i]);
      if (i != 3){
          u8g2.setDrawColor(1);
          u8g2.drawStr(50,name_pos[i],values[i]);
      }

   }

  u8g2.sendBuffer();
}

void winding_menu(void){
  

  int curr_option = 0;
  bool down_button = false;
  bool up_button = false;
  bool conf_button = false;
  bool ret_button = false;

  //default settings
  int angle = 60;
  int len = 500;
  int passes = 1;

      Serial.println("ANGLE");
  Serial.println(angle);

    Serial.println("LEN");
      Serial.println(len);

        Serial.println("PASSES");
          Serial.println(passes);
  

  show_winding_menu(curr_option, angle, len, passes);

  // catch button hold
  while(true){
    conf_button = digitalRead(CONFIRM);
    if (conf_button){
        Serial.println("HOLD");
        Serial.println(conf_button);
        continue;
      } else {
        Serial.println("RESET");
        break;        
      }
  }


  while(true){
      down_button = digitalRead(DOWN);
      up_button = digitalRead(UP);
      conf_button = digitalRead(CONFIRM);
      ret_button = digitalRead(RETURN);

            
      if (conf_button){
        
        switch (curr_option)
        {
          case 0:
            angle = change_winding_angle(angle);
            show_winding_menu(curr_option, angle, len, passes);
            break;
          case 1:
            len = change_winding_length(len);
            show_winding_menu(curr_option, angle, len, passes);
            break;
          case 2:
            passes = change_winding_passes(passes);
            show_winding_menu(curr_option, angle, len, passes);
            break;
          case 3:
            start_winding(angle, len, passes);
            show_winding_menu(0, angle, len, passes);
            break;
        }

        delay(400);
        
      }

      if (down_button){
        Serial.println("DOWN");
        curr_option = move_winding_menu(curr_option, -1, angle, len, passes);
        delay(400);
      }

      if (up_button){
        Serial.println("UP");
        curr_option = move_winding_menu(curr_option, 1, angle, len, passes);
        delay(400);
      }

      if (ret_button){
        break;
      }

  } 
}






void settings_menu(void){
}

void system_test_menu(void){
}






void show_about_menu_two(void){
  Serial.println("SHOW ABOUT TWO");
  u8g2.clearBuffer();

  u8g2.setDrawColor(1);

  //arrow left
  u8g2.setFont(u8g2_font_unifont_t_symbols);
  u8g2.drawGlyph(37, 8, 0x2190);

  
  //8pt font size
  u8g2.setFont(u8g2_font_helvR08_te);
  u8g2.setFontMode(1);

  //Title + Line
  u8g2.drawStr(50,8,"About");
  u8g2.drawHLine(0,9,128);

  // White (1) fonts on black background
  u8g2.setDrawColor(1);
  u8g2.drawStr(2,28,"Idea:");
  u8g2.drawStr(2,39,"Design:");
  u8g2.drawStr(2,50,"Code:");

  u8g2.drawStr(40,28,"Damian Mayer");
  u8g2.drawStr(40,39,"Dawid Dluginski");
  u8g2.drawStr(40,50,"Philipp Kochanski");



  u8g2.sendBuffer();
}

void show_about_menu_one(void){
  Serial.println("SHOW ABOUT ONE");
  u8g2.clearBuffer();

  u8g2.setDrawColor(1);
  //arrow right
  u8g2.setFont(u8g2_font_unifont_t_symbols);
  u8g2.drawGlyph(83, 8, 0x2192);
  
  // copyright
  u8g2.drawGlyph(2,61,0x00a9);

  //8pt font size
  u8g2.setFont(u8g2_font_helvR08_te);
  u8g2.setFontMode(1);

  //Title + Line
  u8g2.drawStr(50,8,"About");
  u8g2.drawHLine(0,9,128);

  // White (1) fonts on black background

  u8g2.drawStr(2,28,"Fibra Filament Winder");
  u8g2.drawStr(2,39,"v.1.0");
  u8g2.drawStr(2,50,"Last Update: 27.05.2018");
  u8g2.drawStr(11,61,"Near Space Technologies");

  u8g2.sendBuffer();
}

int move_about_menu(int cur_pos, int dir){
  Serial.println("MOVE ABOUT MENU");
  Serial.println(cur_pos, dir);
  // return currrent position if out of boundries move detected
  if ((cur_pos == 0 && dir == 1) || (cur_pos == 1 && dir == -1)){
    return cur_pos;
  }

  if (dir == 1){
    cur_pos--;
    show_about_menu_one();
  }

  if (dir == -1){
    cur_pos++;
    show_about_menu_two();
  }

  return cur_pos;
}

void about_menu(void){
  Serial.println("ABOUT MENU");

  int curr_option = 0;
  bool down_button = false;
  bool up_button = false;
  bool ret_button = false;

  show_about_menu_one();

  while(true){
      Serial.println("Running...");
      down_button = digitalRead(DOWN);
      up_button = digitalRead(UP);
      ret_button = digitalRead(RETURN);

      if (ret_button){
        Serial.println("RETURN");
        break;    
      }

      if (down_button){
        curr_option = move_about_menu(curr_option, -1);
        delay(400);
      }

      if (up_button){
        curr_option = move_about_menu(curr_option, 1);
        delay(400);
      }
  } 
}






void loop() {
  main_menu();
}
